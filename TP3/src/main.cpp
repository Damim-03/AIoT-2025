// TP3 - Logistic Regression and XGBoost fire alarm on the ESP32 (Wokwi)
// Both models are the pipelines trained in TP2 (models/LR-Pipeline.pkl and models/XGB-Pipeline.pkl, 12 sensor
// features), exported by tools/export_models.py. The board is an ESP32 instead of the Arduino Uno because the
// XGBoost model (300 trees, 4,922 nodes, about 58 KB) does not fit in the Uno's 32 KB of Flash and 2 KB of RAM.
#include <math.h>
#include "DHT.h"
#include "xgb_model.h" // XGBoost trees and xgb_predict_proba(), generated by tools/export_models.py
#define DHTPIN 15     // Digital pin connected to the DHT sensor
#define DHTTYPE DHT22 // DHT 22  (AM2302), AM2321
DHT dht(DHTPIN, DHTTYPE);

// ---- Logistic Regression parameters, in the training order of the features:
// Temperature_C, Humidity_%, TVOC_ppb, eCO2_ppm, Raw H2, Raw Ethanol, Pressure_hPa, PM1.0, PM2.5, NC0.5, NC1.0, NC2.5
const int N_FEATURES = 12;
const float MEAN[N_FEATURES] = {15.9531155, 48.5743027, 1922.8844, 667.743896, 12942.3008, 19754.25, 938.631958, 100.887283, 186.073914, 490.209259, 205.457794, 81.3197556};
const float STD[N_FEATURES] = {14.3580389, 8.82118797, 7755.89502, 1903.78223, 271.16861, 606.975952, 1.32451439, 925.303528, 1991.52783, 4259.41553, 2232.48486, 1095.29004};
const float WEIGHTS[N_FEATURES] = {-1.10630012, 1.37815046, -18.2296009, 5.91924238, 3.35154843, -7.89639568, -2.42789745, -0.330777943, -0.19455418, -0.454262137, -0.184319511, -0.0682086498};
const float BIAS = -0.384436756;
const float THRESHOLD = 0.5; // same decision rule as Pipeline.predict()

// Input features: the DHT22 replaces X[0] (Temperature) and X[1] (Humidity); the 10 other sensors keep these values
float X[N_FEATURES] = {20.0, 57.36, 0, 400, 12306, 18520, 939.735, 0.0, 0.0, 0.0, 0.0, 0.0};

// x_scaled = (x_raw - mu) / sigma
float standardize(float x_raw, int idx)
{
  return (x_raw - MEAN[idx]) / STD[idx];
}

// y = 1 / (1 + e^-z)
float sigmoid(float z)
{
  return 1.0 / (1.0 + exp(-z));
}

// Logistic Regression: z = sum_i W_i * x_scaled_i + b, then P(fire) = sigmoid(z)
float predict(float features[])
{
  float z = 0.0;
  for (int i = 0; i < N_FEATURES; i++)
  {
    z += WEIGHTS[i] * features[i];
  }
  z += BIAS;
  return sigmoid(z);
}

void printResult(const char *name, float p, unsigned long us)
{
  Serial.print(name);
  Serial.print(F(": P(fire) = "));
  Serial.print(p, 4);
  Serial.print(p >= THRESHOLD ? F(" -> Class 1 (FIRE)  ") : F(" -> Class 0 (normal)"));
  Serial.print(F("  ["));
  Serial.print(us);
  Serial.println(F(" us]"));
}

void setup()
{
  Serial.begin(115200);
  Serial.println(F("TP3 - Logistic Regression and XGBoost fire alarm (ESP32 + DHT22)"));
  dht.begin();
}

void loop()
{
  delay(2000);

  // 1. Read the DHT sensor (about 250 ms; the values may be up to 2 s old)
  float h = dht.readHumidity();
  float t = dht.readTemperature(); // Celsius

  // Check if any reads failed and exit early (to try again).
  if (isnan(h) || isnan(t))
  {
    Serial.println(F("Failed to read from DHT sensor!"));
    return;
  }

  // add data to input array (feature 0 = Temperature, feature 1 = Humidity)
  X[0] = t;
  X[1] = h;

  // 2. Logistic Regression: standardize every feature with the TP2 scaler, then predict
  unsigned long t0 = micros();
  float x_scaled[N_FEATURES];
  for (int i = 0; i < N_FEATURES; i++)
  {
    x_scaled[i] = standardize(X[i], i);
  }
  float p_lr = predict(x_scaled);
  unsigned long us_lr = micros() - t0;

  // 3. XGBoost: the scaler is folded into the tree thresholds, so it takes the raw values
  t0 = micros();
  float p_xgb = xgb_predict_proba(X);
  unsigned long us_xgb = micros() - t0;

  // 4. Print the readings, the probabilities, the classes and the inference times
  Serial.print(F("Temperature: "));
  Serial.print(t);
  Serial.print(F(" C | Humidity: "));
  Serial.print(h);
  Serial.println(F(" %"));
  printResult("  LR ", p_lr, us_lr);
  printResult("  XGB", p_xgb, us_xgb);
}
